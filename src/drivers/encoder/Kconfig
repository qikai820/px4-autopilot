## src/drivers/encoder/mt6701/Kconfig
```kconfig
menuconfig DRIVERS_ENCODER_MT6701
	bool "MagnTek MT6701 I2C absolute angle encoder"
	default n
	---help---
		Enable the MT6701 14-bit absolute angle encoder driver.
```

## src/drivers/viztra/Kconfig
```kconfig
menuconfig DRIVERS_VIZTRA
	bool "viztra"
	default n
	---help---
		Enable the Viztra serial detection and visual tracking driver.
```

## src/modules/dock_guidance/Kconfig
```kconfig
menuconfig MODULES_DOCK_GUIDANCE
	bool "dock_guidance"
	default n
	---help---
		Enable support for dock_guidance
```

## src/modules/geo_att_control/Kconfig
```kconfig
menuconfig MODULES_GEO_ATT_CONTROL
	bool "geo_att_control"
	default n
	---help---
		MorphQuad geometric attitude and angular-rate controller.
```

## src/modules/geo_control/Kconfig
```kconfig
menuconfig MODULES_GEO_CONTROL
	bool "geo_control"
	default n
	---help---
		Enable support for fw_att_control

menuconfig USER_GEO_CONTROL
	bool "geo_control running as userspace module"
	default n
```

## src/modules/geo_pos_control/Kconfig
```kconfig
menuconfig MODULES_GEO_POS_CONTROL
	bool "geo_pos_control"
	default n
	---help---
		MorphQuad geometric position, velocity and force controller.
```

## src/modules/uorb_udp_bridge/Kconfig
```kconfig
menuconfig MODULES_UORB_UDP_BRIDGE
	bool "uORB UDP JSON bridge"
	default n
	---help---
		Publish selected uORB telemetry topics as UDP JSON for PlotJuggler.
```

## src/modules/vector_att_control/Kconfig
```kconfig
menuconfig MODULES_VECTOR_ATT_CONTROL
	bool "vector_att_control"
	default n
	---help---
		Enable support for vector_att_control

menuconfig USER_VECTOR_ATT_CONTROL
	bool "vector_att_control running as userspace module"
	default n
	depends on BOARD_PROTECTED && MODULES_VECTOR_ATT_CONTROL
	---help---
		Put vector_att_control in userspace memory
```

## src/modules/vector_pos_control/Kconfig
```kconfig
menuconfig MODULES_VECTOR_POS_CONTROL
	bool "vector_pos_control"
	default n
	---help---
		Enable support for vector_pos_control

menuconfig USER_VECTOR_POS_CONTROL
	bool "vector_pos_control running as userspace module"
	default y
	depends on BOARD_PROTECTED && MODULES_VECTOR_POS_CONTROL
	---help---
		Put vector_pos_control in userspace memory
```

## src/modules/vector_rate_control/Kconfig
```kconfig
menuconfig MODULES_VECTOR_RATE_CONTROL
	bool "vector_rate_control"
	default n
	---help---
		Enable support for vector_rate_control

menuconfig USER_VECTOR_RATE_CONTROL
	bool "vector_rate_control running as userspace module"
	default n
	depends on BOARD_PROTECTED && MODULES_VECTOR_RATE_CONTROL
	---help---
		Put vector_rate_control in userspace memory
```

## src/systemcmds/inertia_measure/Kconfig
```kconfig
menuconfig SYSTEMCMDS_INERTIA_MEASURE
	bool "inertia_measure"
	default n
	---help---
		Enable the bifilar-pendulum inertia measurement command.
```
